## configs/mx6qluca_defconfig
```kconfig
CONFIG_SYS_EXTRA_OPTIONS="IMX_CONFIG=board/freescale/mx6qluca/mx6qluca.cfg,MX6Q,SYS_USE_SPINOR"
CONFIG_ARM=y
CONFIG_TARGET_MX6QLUCA=y
CONFIG_DM=y
CONFIG_DM_THERMAL=y
```
